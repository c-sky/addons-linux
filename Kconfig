## Kconfig
```kconfig
source addons/drivers/pinctrl/Kconfig
source addons/drivers/clk/Kconfig
source addons/drivers/net/ethernet/Kconfig
```

## addons/Kconfig
```kconfig
source addons/drivers/pinctrl/Kconfig
source addons/drivers/clk/Kconfig
source addons/drivers/clocksource/Kconfig
source addons/drivers/irqchip/Kconfig
source addons/drivers/net/ethernet/Kconfig
source addons/drivers/video/fbdev/Kconfig
```

## addons/drivers/net/ethernet/Kconfig
```kconfig
menu "Ethernet drivers (in addons)"

source addons/drivers/net/ethernet/silan_stmmac/Kconfig
source addons/drivers/net/ethernet/cskymac/Kconfig

endmenu
```

## addons/drivers/net/ethernet/cskymac/Kconfig
```kconfig
config CSKYMAC
	tristate "CSKY mac 10/100baseT support"
	default n
	help
	  If you are configing a CSKY product and wanting to surport net,
	  select this option to make your hardware be drived.
```

## addons/drivers/pinctrl/silan/Kconfig
```kconfig
config PINCTRL_SILAN
	bool "Silan pinctrl driver"
	depends on OF
	select PINCTRL
	select PINMUX
	select PINCONF
	select GENERIC_PINCONF
```

## addons/drivers/video/fbdev/Kconfig
```kconfig
menu "Support for frame buffer devices"

source addons/drivers/video/fbdev/nationalchip/Kconfig

endmenu
```

## drivers/clk/Kconfig
```kconfig
menu "Clock drivers (in addons)"

source addons/drivers/clk/silan/Kconfig

endmenu
```

## drivers/clocksource/Kconfig
```kconfig
menu "Clock Source drivers (in addons)"

config SILAN_SC6138A_TIMER
	bool "silan sc6138a timer"
	select CLKSRC_MMIO
	select CLKSRC_OF
	default n
endmenu
```

## drivers/irqchip/Kconfig
```kconfig
menu "irqchip drivers (in addons)"

config SILAN_SC6138A_IRQ
	bool "silan sc6138a irq"
	select ARM_AMBA
	default n

endmenu
```

## drivers/nationalchip/Kconfig
```kconfig
menu "Nationalchip drivers"

source addons/drivers/nationalchip/nationalchip_eth/Kconfig

endmenu
```

## drivers/net/ethernet/Kconfig
```kconfig
menu "Ethernet drivers (in addons)"

source addons/drivers/net/ethernet/silan_stmmac/Kconfig

endmenu
```

## drivers/net/ethernet/silan_stmmac/Kconfig
```kconfig
config STMMAC_ETH
	tristate "STMicroelectronics 10/100/1000 Ethernet driver"
	select MII
	select PHYLIB
	select CRC32
	depends on NETDEVICES && HAS_IOMEM
	help
	  This is the driver for the Ethernet IPs are built around a
	  Synopsys IP Core and only tested on the STMicroelectronics
	  platforms.

config SILAN_ETH
    bool

if STMMAC_ETH

config SILAN_ETH0
    bool "Silan 10/100/1000 Ethernet0 driver"
	select SILAN_ETH
    default y

choice
	prompt "Silan Ethernet0 Mode"
	depends on SILAN_ETH0
	default SILAN_ETH0_RGMII_MODE
	help
	  Choose Silan Ethernet0 Mode.

config SILAN_ETH0_MII_GMII_MODE
    bool "Silan 10/100/1000 Ethernet1 mii/gmii mode"

config SILAN_ETH0_RGMII_MODE
    bool "Silan 10/100/1000 Ethernet1 rgmii mode"

config SILAN_ETH0_RMII_MODE
    bool "Silan 10/100/1000 Ethernet1 rmii mode"

endchoice

config SILAN_ETH1
    bool "Silan 10/100/1000 Ethernet1 driver"
	select SILAN_ETH
    default y

choice
	prompt "Silan Ethernet1 Mode"
	depends on SILAN_ETH1
	default SILAN_ETH1_RMII_MODE
	help
	  Choose Silan Ethernet1 Mode.

config SILAN_ETH1_MII_GMII_MODE
    bool "Silan 10/100/1000 Ethernet1 mii/gmii mode"

config SILAN_ETH1_RGMII_MODE
    bool "Silan 10/100/1000 Ethernet1 rgmii mode"

config SILAN_ETH1_RMII_MODE
    bool "Silan 10/100/1000 Ethernet1 rmii mode"

endchoice

choice
	prompt "Silan Ethernet SRAM Mode"
	default GMAC_DMADES_NO_USE_SRAM
	help
	  Choose Silan Ethernet SRAM Mode.

config GMAC0_DMADES_USE_SRAM 
    bool "Silan Ethernet0 descriptor on SRAM"
	depends on SILAN_ETH0

config GMAC1_DMADES_USE_SRAM
    bool "Silan Ethernet1 descriptor on SRAM"
	depends on SILAN_ETH0

config GMAC_DMADES_NO_USE_SRAM
    bool "Silan Ethernet descriptor on DDR"

endchoice

config SILAN_GMAC_TX_POSTCHK
    bool "Silan GMAC Tx enhancement: Tx completion post-check"
    default n
    help
        Tx post-check with Tx interrupt disabled, which reduces interrupts
        to the OS. Different from doing the Tx completion work when Tx complete
        interrupt is received, Tx post-check does the work likes below:
        When a packet has been started transmition,
            1) If the network interface is in napi scheduled state, we just do
        nothing as function "stmmac_poll" will call function "stmmac_tx" to finish
        the Tx completion work of the previous transmitted packet when a packet
        is received;
            2) If the network interface is NOT in napi scheduled state, then we
        start napi so that the Tx completion work of the previous transmitted
        packet will be done by function "stmmac_poll"

config STMMAC_DA
	bool "STMMAC DMA arbitration scheme"
	default n
	help
	  Selecting this option, rx has priority over Tx (only for Giga
	  Ethernet device).
	  By default, the DMA arbitration scheme is based on Round-robin
	  (rx:tx priority is 1:1).

config STMMAC_DUAL_MAC
	bool "STMMAC: dual mac support (EXPERIMENTAL)"
	default n
        depends on EXPERIMENTAL && STMMAC_ETH && !STMMAC_TIMER
	help
	  Some ST SoCs (for example the stx7141 and stx7200c2) have two
	  Ethernet Controllers. This option turns on the second Ethernet
	  device on this kind of platforms.

config STMMAC_TIMER
	bool "STMMAC Timer optimisation"
	default n
	depends on RTC_HCTOSYS_DEVICE
	help
	  Use an external timer for mitigating the number of network
	  interrupts. Currently, for SH architectures, it is possible
	  to use the TMU channel 2 and the SH-RTC device.

choice
        prompt "Select Timer device"
        depends on STMMAC_TIMER

config STMMAC_TMU_TIMER
        bool "TMU channel 2"
        depends on CPU_SH4
	help

config STMMAC_RTC_TIMER
        bool "Real time clock"
        depends on RTC_CLASS
	help

endchoice

endif
```

## drivers/pinctrl/Kconfig
```kconfig
menu "Pin controllers (in addons)"

source addons/drivers/pinctrl/silan/Kconfig

endmenu
```

## drivers/silan/Kconfig
```kconfig
config SILAN
	bool "silan drivers"
	select SERIAL_CORE
	select SERIAL_CORE_CONSOLE
	select SERIAL_EARLYCON
	default n
```
